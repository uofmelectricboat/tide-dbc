VERSION ""

NS_ :

BS_:

BU_:

BO_ 3221225472 VECTOR__INDEPENDENT_SIG_MSG: 0 Vector__XXX
 SG_ NewSignal_0025 : 48|8@1+ (1,0) [0|0] "" Vector__XXX

BO_ 2683483647 BatteryBP01: 8 Vector__XXX
 SG_ Pressure_Tx : 0|32@1- (1,0) [-14.5|10000] "psi" Vector__XXX
 SG_ Temp_Tx : 32|16@1- (1,0) [-50|250] "C" Vector__XXX

BO_ 2683483646 BatteryBP02: 8 Vector__XXX
 SG_ pressure_tx : 0|32@1- (1,0) [-14.5|10000] "psi" Vector__XXX
 SG_ temp_tx : 32|16@1- (1,0) [-50|250] "c" Vector__XXX

BO_ 2683483645 BatteryBP03: 8 Vector__XXX
 SG_ pressure_tx : 0|32@1- (1,0) [-14.5|10000] "psi" Vector__XXX
 SG_ temp_tx : 32|16@1- (1,0) [-50|250] "" Vector__XXX

BO_ 2683483644 BatteryBP04: 8 Vector__XXX
 SG_ pressure_tx : 0|32@1- (1,0) [-14.5|10000] "psi" Vector__XXX
 SG_ temp_tx : 32|16@1- (1,0) [-50|250] "c" Vector__XXX

BO_ 2683483643 BatteryBP05: 8 Vector__XXX
 SG_ pressure_tx : 0|32@1- (1,0) [-14.5|10000] "psi" Vector__XXX
 SG_ temp_tx : 32|16@1- (1,0) [-50|250] "c" Vector__XXX

BO_ 2683483642 BatteryBP06: 8 Vector__XXX
 SG_ pressure_tx : 0|32@1- (1,0) [-14.5|10000] "psi" Vector__XXX
 SG_ temp_tx : 32|16@1- (1,0) [-50|250] "c" Vector__XXX

BO_ 2683483641 BatterySupply: 8 Vector__XXX
 SG_ Flowmeter : 0|32@1- (1,0) [0|0] "L/min" Vector__XXX
 SG_ pressure_tx : 32|32@1- (1,0) [-14.5|10000] "psi" Vector__XXX

BO_ 2683483640 HeatExchanger: 8 Vector__XXX
 SG_ pressure_tx : 0|32@1- (1,0) [-14.5|10000] "psi" Vector__XXX
 SG_ temp_tx : 32|16@1- (1,0) [-50|250] "c" Vector__XXX

BO_ 2683483639 MasterSupply: 8 Vector__XXX
 SG_ Temp_tx : 0|16@1- (1,0) [-50|250] "c" Vector__XXX

BO_ 2683483638 Pump: 8 Vector__XXX
 SG_ Pump_suck_pressure_tx : 0|32@1- (1,0) [-14.5|10000] "psi" Vector__XXX
 SG_ pump_discharge_pressure_tx : 32|32@1- (1,0) [-14.5|10000] "psi" Vector__XXX

BO_ 2683483637 Inverter_return_pressure: 8 Vector__XXX
 SG_ inverter01_pressure : 0|32@1- (1,0) [-14.5|10000] "psi" Vector__XXX
 SG_ inverter02_pressure : 32|32@1- (1,0) [-145|10000] "psi" Vector__XXX

BO_ 2683483636 Inverter_return_temp: 8 Vector__XXX
 SG_ temp_tx : 0|16@1- (1,0) [-50|250] "c" Vector__XXX

BO_ 2683483635 Inverter_supply: 8 Vector__XXX
 SG_ Flowmeter : 0|32@1- (1,0) [0|0] "Liters/min" Vector__XXX
 SG_ pressure_tx : 32|32@1- (1,0) [-14.5|10000] "psi" Vector__XXX

BO_ 2683483634 Motor_return: 8 Vector__XXX
 SG_ pressure_tx : 0|32@1- (1,0) [-145|10000] "psi" Vector__XXX
 SG_ temp_tx : 32|16@1- (1,0) [-50|250] "c" Vector__XXX

BO_ 2683372533 Motor_supply: 8 Vector__XXX
 SG_ flowmeter : 0|32@1- (1,0) [0|0] "Liters/minute" Vector__XXX
 SG_ pressure_tx : 32|32@1- (1,0) [-14.5|10000] "psi" Vector__XXX

SIG_VALTYPE_ 2683483647 Pressure_Tx : 1;
SIG_VALTYPE_ 2683483646 pressure_tx : 1;
SIG_VALTYPE_ 2683483645 pressure_tx : 1;
SIG_VALTYPE_ 2683483644 pressure_tx : 1;
SIG_VALTYPE_ 2683483643 pressure_tx : 1;
SIG_VALTYPE_ 2683483642 pressure_tx : 1;
SIG_VALTYPE_ 2683483641 Flowmeter : 1;
SIG_VALTYPE_ 2683483641 pressure_tx : 1;
SIG_VALTYPE_ 2683483640 pressure_tx : 1;
SIG_VALTYPE_ 2683483638 Pump_suck_pressure_tx : 1;
SIG_VALTYPE_ 2683483638 pump_discharge_pressure_tx : 1;
SIG_VALTYPE_ 2683483637 inverter01_pressure : 1;
SIG_VALTYPE_ 2683483637 inverter02_pressure : 1;
SIG_VALTYPE_ 2683483635 Flowmeter : 1;
SIG_VALTYPE_ 2683483635 pressure_tx : 1;
SIG_VALTYPE_ 2683483634 pressure_tx : 1;
SIG_VALTYPE_ 2683372533 flowmeter : 1;
SIG_VALTYPE_ 2683372533 pressure_tx : 1;
